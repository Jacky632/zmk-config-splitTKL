## config/boards/shields/Kconfig.defconfig
```kconfig
if SHIELD_SPLITTKL_LEFT

config ZMK_KEYBOARD_NAME
    default "splitTKL"

config ZMK_SPLIT_ROLE_CENTRAL
    default y

endif

if SHIELD_SPLITTKL_LEFT || SHIELD_SPLITTKL_RIGHT

config ZMK_SPLIT
    default y

endif
```

## config/boards/shields/splitTKL/Kconfig.shield
```kconfig
config SHIELD_SPLITTKL_LEFT
    def_bool $(shields_list_contains,splitTKL_left)

config SHIELD_SPLITTKL_RIGHT
    def_bool $(shields_list_contains,splitTKL_right)
```
