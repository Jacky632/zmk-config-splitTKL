/* splitTKL_right.overlay */
#include "splitTKL.dtsi"

/* bump every RC(column) by +7 so RC(0,0)→RC(0,3), etc. */
&default_transform {
    col-offset = <7>;
};

&kscan0 {
    /* right-half rows */
    row-gpios = 
        <&pro_micro 16 (GPIO_ACTIVE_HIGH | GPIO_PULL_DOWN)>,
        <&pro_micro 14 (GPIO_ACTIVE_HIGH | GPIO_PULL_DOWN)>,
        <&pro_micro 15 (GPIO_ACTIVE_HIGH | GPIO_PULL_DOWN)>,
        <&pro_micro 18 (GPIO_ACTIVE_HIGH | GPIO_PULL_DOWN)>,
        <&pro_micro 19 (GPIO_ACTIVE_HIGH | GPIO_PULL_DOWN)>,
        <&pro_micro 20 (GPIO_ACTIVE_HIGH | GPIO_PULL_DOWN)>;

    /* right-half columns */
    col-gpios =
        <&pro_micro 1 GPIO_ACTIVE_HIGH>,
        <&pro_micro 0 GPIO_ACTIVE_HIGH>,
        <&pro_micro 2 GPIO_ACTIVE_HIGH>,
        <&pro_micro 3 GPIO_ACTIVE_HIGH>,
        <&pro_micro 4 GPIO_ACTIVE_HIGH>,
        <&pro_micro 5 GPIO_ACTIVE_HIGH>,
        <&pro_micro 6 GPIO_ACTIVE_HIGH>,
        <&pro_micro 7 GPIO_ACTIVE_HIGH>,
        <&pro_micro 8 GPIO_ACTIVE_HIGH>,
        <&pro_micro 9 GPIO_ACTIVE_HIGH>,
        <&pro_micro 21 GPIO_ACTIVE_HIGH>;
};





